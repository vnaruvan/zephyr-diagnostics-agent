## CMakeLists.txt
```
# SPDX-License-Identifier: Apache-2.0

cmake_minimum_required(VERSION 3.20.0)

find_package(Zephyr REQUIRED HINTS $ENV{ZEPHYR_BASE})
project(zephyr_diagnostics_agent)

target_sources(app PRIVATE
    src/main.c
    src/health.c
    src/diagnostics.c
    src/shell_cmds.c
)
```

## prj.conf
```kconfig
CONFIG_PRINTK=y

CONFIG_LOG=y
CONFIG_LOG_DEFAULT_LEVEL=3
CONFIG_LOG_MODE_IMMEDIATE=y

CONFIG_SHELL=y
CONFIG_CONSOLE=y
CONFIG_UART_CONSOLE=y
CONFIG_SERIAL=y
```

## src/main.c
```c
#include <zephyr/kernel.h>
#include <zephyr/logging/log.h>
#include <zephyr/sys/printk.h>
#include <zephyr/sys/util.h>

#include "diagnostics.h"

LOG_MODULE_REGISTER(diagnostics_agent, LOG_LEVEL_INF);

static void diagnostics_work_handler(struct k_work *work);
static void diagnostics_timer_handler(struct k_timer *timer);

K_WORK_DEFINE(diagnostics_work, diagnostics_work_handler);
K_TIMER_DEFINE(diagnostics_timer, diagnostics_timer_handler, NULL);

static void diagnostics_timer_handler(struct k_timer *timer)
{
    ARG_UNUSED(timer);

    k_work_submit(&diagnostics_work);
}

static void diagnostics_work_handler(struct k_work *work)
{
    ARG_UNUSED(work);

    diagnostics_tick();

    struct health_state state = diagnostics_get_state();

    printk("health=%s sensor=%d threshold=%d updates=%u errors=%u\n",
           diagnostics_status_to_string(state.status),
           state.sensor_value,
           state.threshold,
           state.update_count,
           state.error_count);

    if (state.status == HEALTH_OK) {
        LOG_INF("health=%s sensor=%d threshold=%d updates=%u errors=%u",
                diagnostics_status_to_string(state.status),
                state.sensor_value,
                state.threshold,
                state.update_count,
                state.error_count);
    } else if (state.status == HEALTH_WARN) {
        LOG_WRN("health=%s sensor=%d threshold=%d updates=%u errors=%u",
                diagnostics_status_to_string(state.status),
                state.sensor_value,
                state.threshold,
                state.update_count,
                state.error_count);
    } else {
        LOG_ERR("health=%s sensor=%d threshold=%d updates=%u errors=%u",
                diagnostics_status_to_string(state.status),
                state.sensor_value,
                state.threshold,
                state.update_count,
                state.error_count);
    }
}

int main(void)
{
    printk("starting Zephyr diagnostics agent\n");
    LOG_INF("starting Zephyr diagnostics agent");

    diagnostics_init(75);

    struct health_state state = diagnostics_get_state();

    printk("health monitor initialized with threshold=%d\n", state.threshold);
    LOG_INF("health monitor initialized with threshold=%d", state.threshold);

    k_timer_start(&diagnostics_timer, K_SECONDS(1), K_SECONDS(1));

    while (1) {
        k_sleep(K_SECONDS(10));
    }

    return 0;
}
```

## src/diagnostics.c
```c
#include "diagnostics.h"

static struct health_state current_health;
static int simulated_sensor_value = 60;

void diagnostics_init(int threshold)
{
    simulated_sensor_value = 60;
    health_init(&current_health, threshold);
}

void diagnostics_tick(void)
{
    simulated_sensor_value += 5;

    if (simulated_sensor_value > 100) {
        simulated_sensor_value = 50;
    }

    health_update(&current_health, simulated_sensor_value);
}

void diagnostics_reset(void)
{
    simulated_sensor_value = 60;
    health_reset(&current_health);
}

void diagnostics_inject_error(void)
{
    health_force_error(&current_health);
}

void diagnostics_set_threshold(int threshold)
{
    health_set_threshold(&current_health, threshold);
}

struct health_state diagnostics_get_state(void)
{
    return current_health;
}

const char *diagnostics_status_to_string(enum health_status status)
{
    switch (status) {
    case HEALTH_OK:
        return "OK";
    case HEALTH_WARN:
        return "WARN";
    case HEALTH_ERROR:
        return "ERROR";
    default:
        return "UNKNOWN";
    }
}
```

## src/diagnostics.h
```c
#ifndef DIAGNOSTICS_H
#define DIAGNOSTICS_H

#include "health.h"

void diagnostics_init(int threshold);
void diagnostics_tick(void);
void diagnostics_reset(void);
void diagnostics_inject_error(void);
void diagnostics_set_threshold(int threshold);
struct health_state diagnostics_get_state(void);
const char *diagnostics_status_to_string(enum health_status status);

#endif
```

## src/health.c
```c
#include <stddef.h>

#include "health.h"

void health_init(struct health_state *state, int threshold)
{
    if (state == NULL) {
        return;
    }

    state->sensor_value = 0;
    state->threshold = threshold;
    state->update_count = 0;
    state->error_count = 0;
    state->status = HEALTH_OK;
}

void health_update(struct health_state *state, int sensor_value)
{
    if (state == NULL) {
        return;
    }

    state->sensor_value = sensor_value;
    state->update_count++;

    if (sensor_value > state->threshold) {
        state->status = HEALTH_WARN;
        state->error_count++;
    } else {
        state->status = HEALTH_OK;
    }
}

void health_reset(struct health_state *state)
{
    if (state == NULL) {
        return;
    }

    state->sensor_value = 0;
    state->update_count = 0;
    state->error_count = 0;
    state->status = HEALTH_OK;
}

void health_force_error(struct health_state *state)
{
    if (state == NULL) {
        return;
    }

    state->status = HEALTH_ERROR;
    state->error_count++;
}

void health_set_threshold(struct health_state *state, int threshold)
{
    if (state == NULL) {
        return;
    }

    state->threshold = threshold;
}
```

## src/health.h
```c
#ifndef HEALTH_H
#define HEALTH_H

#include <stdint.h>

enum health_status {
    HEALTH_OK = 0,
    HEALTH_WARN = 1,
    HEALTH_ERROR = 2
};

struct health_state {
    int sensor_value;
    int threshold;
    uint32_t update_count;
    uint32_t error_count;
    enum health_status status;
};

void health_init(struct health_state *state, int threshold);
void health_update(struct health_state *state, int sensor_value);
void health_reset(struct health_state *state);
void health_force_error(struct health_state *state);
void health_set_threshold(struct health_state *state, int threshold);

#endif
```

## src/shell_cmds.c
```c
#include <errno.h>
#include <stdlib.h>

#include <zephyr/shell/shell.h>
#include <zephyr/sys/util.h>

#include "diagnostics.h"

static int cmd_health_status(const struct shell *sh, size_t argc, char **argv)
{
    ARG_UNUSED(argc);
    ARG_UNUSED(argv);

    struct health_state state = diagnostics_get_state();

    shell_print(sh, "health=%s sensor=%d threshold=%d updates=%u errors=%u",
                diagnostics_status_to_string(state.status),
                state.sensor_value,
                state.threshold,
                state.update_count,
                state.error_count);

    return 0;
}

static int cmd_health_reset(const struct shell *sh, size_t argc, char **argv)
{
    ARG_UNUSED(argc);
    ARG_UNUSED(argv);

    diagnostics_reset();

    shell_print(sh, "health state reset");

    return 0;
}

static int cmd_health_inject_error(const struct shell *sh, size_t argc, char **argv)
{
    ARG_UNUSED(argc);
    ARG_UNUSED(argv);

    diagnostics_inject_error();

    struct health_state state = diagnostics_get_state();

    shell_print(sh, "injected error: health=%s errors=%u",
                diagnostics_status_to_string(state.status),
                state.error_count);

    return 0;
}

static int cmd_health_threshold(const struct shell *sh, size_t argc, char **argv)
{
    if (argc != 2) {
        shell_error(sh, "usage: health threshold <value>");
        return -EINVAL;
    }

    int threshold = (int)strtol(argv[1], NULL, 10);

    diagnostics_set_threshold(threshold);

    shell_print(sh, "threshold set to %d", threshold);

    return 0;
}

SHELL_STATIC_SUBCMD_SET_CREATE(health_cmds,
    SHELL_CMD(status, NULL, "Show health status", cmd_health_status),
    SHELL_CMD(reset, NULL, "Reset health state", cmd_health_reset),
    SHELL_CMD(inject_error, NULL, "Inject simulated error", cmd_health_inject_error),
    SHELL_CMD(threshold, NULL, "Set threshold: health threshold <value>", cmd_health_threshold),
    SHELL_SUBCMD_SET_END
);

SHELL_CMD_REGISTER(health, &health_cmds, "Health diagnostics commands", NULL);
```
